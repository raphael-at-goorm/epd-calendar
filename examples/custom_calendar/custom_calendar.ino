#ifndef BOARD_HAS_PSRAM
#error "PSRAM must be enabled: Arduino IDE -> Tools -> PSRAM -> OPI PSRAM"
#endif

#include <Arduino.h>
#include <WiFi.h>
#include <ArduinoOTA.h>
#include <HTTPClient.h>
#include <WiFiClientSecure.h>
#include <HTTPUpdate.h>
#include <time.h>
#include <string.h>

// Build version is generated by scripts/gen_build_id.py at compile time.
// Format: vYYMMDDHHMM_XXXXXX  (e.g. v2604251630_AB3X7K)
#include "build_version.h"
#define FIRMWARE_VERSION BUILD_VERSION

#include "epd_driver.h"
#include "config.h"
#include "secrets.h"
#include "calendar_data.h"
#include "google_auth.h"
#include "google_calendar.h"
#include "layout_weekly.h"
#include "layout_meeting.h"
#include "render_utils.h"

// ── Font includes (generated — see scripts/gen_fonts_kr.sh) ──────────────────
#include "fonts/NotoSansKR_8.h"
#include "fonts/NotoSansKR_12.h"
#include "fonts/NotoSansKR_16.h"
#include "fonts/NotoSansKR_24.h"
#include "fonts/NotoSansKR_36.h"

// ── Sleep screen image ────────────────────────────────────────────────────────
#include "cat_image.h"

// ── State ─────────────────────────────────────────────────────────────────────
// MODE_WEEKLY  : default view (always shown outside meeting time)
// MODE_MEETING : shown ≤10 min before / during an event
// MODE_SLEEP   : 00:00–09:00 KST — minimal display, OTA still handled
// MODE_AUTH_SETUP / MODE_ERROR : boot-time states
enum DisplayMode { MODE_WEEKLY, MODE_MEETING, MODE_SLEEP, MODE_AUTH_SETUP, MODE_ERROR };

static CalendarData  g_calData;
static uint8_t      *g_fb = nullptr;
static DisplayMode   g_mode = MODE_WEEKLY;
static int           g_activeMeetingIdx = -1;
static bool          g_activeMeetingInProgress = false;

static unsigned long g_lastCalFetch = 0;
static int           g_lastDrawnHalfHourSlot = -1;  // 0-47, -1=never
static int           g_lastDailyRepairYday = -1;

// ── Screen repair tuning ─────────────────────────────────────────────────────
#define REPAIR_PULSE_TIME        50
#define REPAIR_PULSE_DELAY_MS    500
#define BOOT_REPAIR_DARK_PULSES  24
#define BOOT_REPAIR_LIGHT_PULSES 48
#define DAILY_REPAIR_DARK_PULSES 16
#define DAILY_REPAIR_LIGHT_PULSES 32

// ── Helpers ───────────────────────────────────────────────────────────────────
static bool isClockSynced(time_t t) {
    return t > 1700000000UL;
}

static bool isSleepHours(time_t t) {
    struct tm lt; localtime_r(&t, &lt);
    return lt.tm_hour < 9;   // 00:00–08:59 KST
}

static bool isRefreshAllowed(time_t t) {
    struct tm lt; localtime_r(&t, &lt);
    return lt.tm_hour >= 9;  // 09:00–23:59 KST
}

static int halfHourSlot(time_t t) {
    struct tm lt;
    localtime_r(&t, &lt);
    return lt.tm_hour * 2 + (lt.tm_min >= 30 ? 1 : 0);
}

static int dayOfYear(time_t t) {
    struct tm lt;
    localtime_r(&t, &lt);
    return lt.tm_yday;
}

// ── HTTP pull OTA ─────────────────────────────────────────────────────────────
// Enabled only when OTA_VERSION_URL is defined in secrets.h.
// Device fetches version.txt; if it differs from FIRMWARE_VERSION it
// downloads firmware.bin from OTA_FIRMWARE_URL and reboots automatically.
#ifdef OTA_VERSION_URL
static unsigned long g_lastHttpOtaMs = 0;
#define HTTP_OTA_INTERVAL_MS (60UL * 60UL * 1000UL)  // check every hour

static void checkHttpOta() {
    Serial.println("[ota] checking for http update…");
    WiFiClientSecure verClient;
    verClient.setInsecure();
    HTTPClient http;
    http.begin(verClient, OTA_VERSION_URL);
    http.setFollowRedirects(HTTPC_FORCE_FOLLOW_REDIRECTS);
    http.setRedirectLimit(5);
    http.setTimeout(8000);
    int code = http.GET();
    if (code != 200) {
        Serial.printf("[ota] version fetch failed: %d\n", code);
        http.end();
        return;
    }
    String latest = http.getString();
    http.end();
    latest.trim();

    Serial.printf("[ota] local=%s  remote=%s\n", FIRMWARE_VERSION, latest.c_str());
    if (latest == String(FIRMWARE_VERSION)) return;

    Serial.printf("[ota] updating %s → %s\n", FIRMWARE_VERSION, latest.c_str());
    WiFiClientSecure dlClient;
    dlClient.setInsecure();
    httpUpdate.rebootOnUpdate(true);
    httpUpdate.setFollowRedirects(HTTPC_FORCE_FOLLOW_REDIRECTS);
    t_httpUpdate_return ret = httpUpdate.update(dlClient, OTA_FIRMWARE_URL);
    if (ret == HTTP_UPDATE_FAILED) {
        Serial.printf("[ota] failed (%d): %s\n",
                      httpUpdate.getLastError(),
                      httpUpdate.getLastErrorString().c_str());
    }
}
#endif

// ── WiFi ──────────────────────────────────────────────────────────────────────
static void wifiConnect() {
    if (WiFi.status() == WL_CONNECTED) return;
    WiFi.mode(WIFI_STA);
    WiFi.begin(WIFI_SSID, WIFI_PASSWORD);
    Serial.print("[wifi] connecting");
    for (int i = 0; i < 40 && WiFi.status() != WL_CONNECTED; i++) {
        delay(500);
        Serial.print('.');
    }
    Serial.println();
    if (WiFi.status() == WL_CONNECTED)
        Serial.printf("[wifi] IP %s\n", WiFi.localIP().toString().c_str());
    else
        Serial.println("[wifi] failed");
}

// ── NTP ───────────────────────────────────────────────────────────────────────
static bool ntpSync() {
    configTzTime(TIMEZONE_POSIX, NTP_SERVER_1, NTP_SERVER_2);
    Serial.print("[ntp] syncing");
    time_t now;
    for (int i = 0; i < 30; i++) {
        time(&now);
        if (isClockSynced(now)) { Serial.println(" ok"); return true; }
        delay(500);
        Serial.print('.');
    }
    Serial.println(" timeout");
    return false;
}

// ── Framebuffer helpers ───────────────────────────────────────────────────────
static void fbClear() {
    memset(g_fb, 0xFF, EPD_WIDTH * EPD_HEIGHT / 2);
}

// Full-screen refresh schedule (clock-aligned):
//   4-cycle: 00:00 / 04:00 / 08:00 / 12:00 / 16:00 / 20:00 (or forced on mode transition)
//   2-cycle: every :00 and :30 of each hour
//   soft   : otherwise (no clear, just redraw)
static int  g_lastRefresh2MinOfDay = -1;
static int  g_lastRefresh4MinOfDay = -1;
static bool g_forceFullClear = true;  // 4-cycle on first boot / mode transition

static void fbFlush() {
    time_t t = time(nullptr);
    struct tm lt;
    localtime_r(&t, &lt);
    int minOfDay = lt.tm_hour * 60 + lt.tm_min;

    epd_poweron();
    if (g_forceFullClear) {
        epd_clear_area_cycles(epd_full_screen(), 4, 50);
        g_lastRefresh4MinOfDay = minOfDay;
        g_lastRefresh2MinOfDay = minOfDay;
        g_forceFullClear = false;
    } else if ((lt.tm_hour % 4 == 0) && (lt.tm_min == 0) &&
               (minOfDay != g_lastRefresh4MinOfDay)) {
        epd_clear_area_cycles(epd_full_screen(), 4, 50);
        g_lastRefresh4MinOfDay = minOfDay;
        g_lastRefresh2MinOfDay = minOfDay;
    } else if ((lt.tm_min % 30 == 0) &&
               (minOfDay != g_lastRefresh2MinOfDay)) {
        epd_clear_area_cycles(epd_full_screen(), 2, 50);
        g_lastRefresh2MinOfDay = minOfDay;
    }
    epd_draw_grayscale_image(epd_full_screen(), g_fb);
    epd_poweroff();
}

// Force a 4-cycle full clear on the next flush (call before mode transitions)
static void fbRequestFullClear() {
    g_forceFullClear = true;
}

static void runScreenRepair(const char *reason,
                            int darkPulses,
                            int lightPulses,
                            int finalClearCycles) {
    Serial.printf("[repair] %s start dark=%d light=%d final_clear=%d\n",
                  reason, darkPulses, lightPulses, finalClearCycles);

    Rect_t area = epd_full_screen();
    epd_poweron();
    delay(10);

    epd_clear();
    for (int i = 0; i < darkPulses; i++) {
        epd_push_pixels(area, REPAIR_PULSE_TIME, 0);
        delay(REPAIR_PULSE_DELAY_MS);
    }

    epd_clear();
    for (int i = 0; i < lightPulses; i++) {
        epd_push_pixels(area, REPAIR_PULSE_TIME, 1);
        delay(REPAIR_PULSE_DELAY_MS);
    }

    epd_clear_area_cycles(area, finalClearCycles, REPAIR_PULSE_TIME);
    epd_poweroff_all();

    if (g_fb) fbClear();
    g_forceFullClear = false;
    Serial.println("[repair] done");
}

static bool runDailyRepairIfDue(time_t now) {
    if (!isClockSynced(now)) return false;

    struct tm lt;
    localtime_r(&now, &lt);
    if (lt.tm_hour != 0) return false;
    if (g_lastDailyRepairYday == lt.tm_yday) return false;

    runScreenRepair("daily-midnight",
                    DAILY_REPAIR_DARK_PULSES,
                    DAILY_REPAIR_LIGHT_PULSES,
                    6);
    g_lastDailyRepairYday = lt.tm_yday;
    return true;
}

// Flash a rectangular area: strong EPD clear then redraw to eliminate ghost.
static void flashArea(int x, int y1, int w, int h, int cycles = 2, int cycle_time = 50) {
    if (h <= 0 || w <= 0) return;
    if (y1 < 0)              { h += y1; y1 = 0; }
    if (y1 + h > EPD_HEIGHT) h = EPD_HEIGHT - y1;
    if (x < 0)               { w += x;  x  = 0; }
    if (x + w > EPD_WIDTH)   w = EPD_WIDTH - x;
    if (h <= 0 || w <= 0) return;

    int rowBytes   = EPD_WIDTH / 2;
    int bandBytes  = rowBytes * h;
    int bandOffset = rowBytes * y1;

    uint8_t *saved = (uint8_t *)ps_malloc(bandBytes);
    if (!saved) return;
    memcpy(saved, g_fb + bandOffset, bandBytes);

    Rect_t band = {.x=x, .y=y1, .width=w, .height=h};

    epd_poweron();
    epd_clear_area_cycles(band, cycles, cycle_time);
    memcpy(g_fb + bandOffset, saved, bandBytes);
    epd_draw_grayscale_image(band, g_fb + bandOffset);
    epd_poweroff();

    free(saved);
}

// ── Auth setup screen ─────────────────────────────────────────────────────────
static void showAuthSetup(const DeviceCodeInfo &info) {
    fbClear();
    int y = 50;
    rutil_textCentered(&NotoSansKR_24, "Google 캘린더 인증이 필요합니다",
                       0, SCREEN_W, y, g_fb);
    y += 46;

    rutil_hline(40, y, SCREEN_W - 80, 0xBB, g_fb);
    y += 16;

    rutil_textCentered(&NotoSansKR_24, "아래 주소에 접속하여 코드를 입력하세요:",
                       0, SCREEN_W, y, g_fb);
    y += 42;

    rutil_textCentered(&NotoSansKR_24, info.verificationUrl.c_str(),
                       0, SCREEN_W, y, g_fb);
    y += 44;

    rutil_hline(40, y, SCREEN_W - 80, 0xBB, g_fb);
    y += 16;

    char codeLine[64];
    snprintf(codeLine, sizeof(codeLine), "코드:  %s", info.userCode.c_str());
    rutil_textCentered(&NotoSansKR_36, codeLine, 0, SCREEN_W, y, g_fb);
    y += 50;

    rutil_hline(40, y, SCREEN_W - 80, 0xBB, g_fb);
    y += 20;

    rutil_textCentered(&NotoSansKR_24, "인증 완료 후 자동으로 캘린더가 시작됩니다.",
                       0, SCREEN_W, y, g_fb);
    fbFlush();
}

// ── Sleep screen (00:00–09:00) ────────────────────────────────────────────────
static void drawSleepScreen() {
    fbClear();
    // Draw cat image centered
    Rect_t cat_rect = {
        .x      = (EPD_WIDTH  - (int)cat_image_width)  / 2,
        .y      = (EPD_HEIGHT - (int)cat_image_height) / 2,
        .width  = (int)cat_image_width,
        .height = (int)cat_image_height
    };
    epd_copy_to_framebuffer(cat_rect, (uint8_t*)cat_image_data, g_fb);
    fbFlush();
}

// ── Redraw full screen ────────────────────────────────────────────────────────
static void redrawScreen() {
    time_t now = time(nullptr);
    fbClear();

    if (g_mode == MODE_SLEEP) {
        drawSleepScreen();
        return;  // drawSleepScreen calls fbFlush already
    }

    if (g_mode == MODE_MEETING && g_activeMeetingIdx >= 0) {
        layout_meeting_draw(g_fb, g_calData, now,
                            g_calData.events[g_activeMeetingIdx]);
    } else {
        layout_weekly_draw(g_fb, g_calData, now);
    }

    fbFlush();
}

// ── Setup ─────────────────────────────────────────────────────────────────────
void setup() {
    Serial.begin(115200);
    delay(500);

    epd_init();

    g_fb = (uint8_t *)ps_calloc(EPD_WIDTH * EPD_HEIGHT / 2, 1);
    if (!g_fb) { Serial.println("PSRAM alloc failed!"); while (1); }
    fbClear();

    runScreenRepair("boot",
                    BOOT_REPAIR_DARK_PULSES,
                    BOOT_REPAIR_LIGHT_PULSES,
                    8);
    fbRequestFullClear();

    // Splash
    epd_poweron();
    epd_clear();
    {
        int32_t cx = SCREEN_W / 2 - 160, cy = SCREEN_H / 2;
        writeln((GFXfont *)&NotoSansKR_36,
                "캘린더 시작 중...", &cx, &cy, nullptr);
    }
    epd_poweroff();

    wifiConnect();
    if (ntpSync()) {
        g_lastDailyRepairYday = dayOfYear(time(nullptr));
    }

    // OTA update
    ArduinoOTA.setHostname("epd-calendar");
    ArduinoOTA.onStart([]() { Serial.println("[ota] starting"); });
    ArduinoOTA.onEnd([]()   { Serial.println("[ota] done");     });
    ArduinoOTA.onProgress([](unsigned int p, unsigned int t) {
        Serial.printf("[ota] %u%%\n", p * 100 / t);
    });
    ArduinoOTA.onError([](ota_error_t e) {
        Serial.printf("[ota] error %u\n", e);
    });
    ArduinoOTA.begin();
    Serial.printf("[ota] ready  ip=%s  host=epd-calendar\n",
                  WiFi.localIP().toString().c_str());

#ifdef OTA_VERSION_URL
    checkHttpOta();
    g_lastHttpOtaMs = millis();
#endif

    // Google auth
    if (!gauth_init()) {
        DeviceCodeInfo info;
        if (!gauth_requestDeviceCode(info)) {
            Serial.println("[auth] Failed to get device code");
            return;
        }
        showAuthSetup(info);

        Serial.printf("[auth] Visit %s  Code: %s\n",
                      info.verificationUrl.c_str(), info.userCode.c_str());
        unsigned long deadline = millis() + (unsigned long)info.expiresIn * 1000UL;
        while (millis() < deadline) {
            delay((unsigned long)info.interval * 1000UL);
            if (gauth_pollDeviceAuth(info)) {
                Serial.println("[auth] Authorized!");
                break;
            }
        }
    }

    if (!gauth_hasToken()) {
        Serial.println("[auth] No token — cannot fetch calendar");
        g_mode = MODE_ERROR;
        return;
    }

    // Initial calendar fetch (skip if it's sleep hours)
    time_t bootNow = time(nullptr);
    if (isRefreshAllowed(bootNow)) {
        gcal_fetchEvents(g_calData);
    }
    g_lastCalFetch = millis();

    redrawScreen();
    g_lastDrawnHalfHourSlot = halfHourSlot(time(nullptr));
}

// ── Loop ──────────────────────────────────────────────────────────────────────
void loop() {
    if (g_mode == MODE_ERROR) {
        for (int i = 0; i < 120; i++) { ArduinoOTA.handle(); delay(500); }
        return;
    }

    unsigned long now_ms = millis();
    time_t        now    = time(nullptr);
    int           currentHalfHourSlot = halfHourSlot(now);

    bool needFullRedraw = false;
    bool repairedThisLoop = false;

#ifdef OTA_VERSION_URL
    if (now_ms - g_lastHttpOtaMs >= HTTP_OTA_INTERVAL_MS) {
        g_lastHttpOtaMs = now_ms;
        wifiConnect();
        checkHttpOta();
    }
#endif

    repairedThisLoop = runDailyRepairIfDue(now);

    // ── Sleep gate: 00:00–09:00 KST ──────────────────────────────────────────
    if (isSleepHours(now)) {
        if (g_mode != MODE_SLEEP) {
            g_mode = MODE_SLEEP;
            g_activeMeetingIdx = -1;
            g_activeMeetingInProgress = false;
            if (!repairedThisLoop) fbRequestFullClear();
            drawSleepScreen();
        }
        unsigned long deadline = millis() + 60000UL;
        while ((long)(deadline - millis()) > 0) {
            ArduinoOTA.handle();
            delay(500);
        }
        return;
    }

    // ── Wake from sleep ───────────────────────────────────────────────────────
    if (g_mode == MODE_SLEEP) {
        g_mode = MODE_WEEKLY;
        wifiConnect();
        gcal_fetchEvents(g_calData);
        g_lastCalFetch = now_ms;
        g_activeMeetingInProgress = false;
        needFullRedraw = true;
    }

    // ── Calendar data refresh every 1 min; display redraw stays 30-min based ─
    if (!needFullRedraw &&
        isRefreshAllowed(now) &&
        now_ms - g_lastCalFetch >= CALENDAR_FETCH_INTERVAL_MS) {
        wifiConnect();
        gcal_fetchEvents(g_calData);
        g_lastCalFetch = now_ms;
    }

    // ── Meeting detection ─────────────────────────────────────────────────────
    int meetingIdx = findActiveMeetingIndex(g_calData, now);

    if (meetingIdx >= 0) {
        bool meetingInProgress = (now >= g_calData.events[meetingIdx].startTime);
        if (g_mode != MODE_MEETING || g_activeMeetingIdx != meetingIdx) {
            g_mode = MODE_MEETING;
            g_activeMeetingIdx = meetingIdx;
            g_activeMeetingInProgress = meetingInProgress;
            fbRequestFullClear();
            needFullRedraw = true;
        } else if (g_activeMeetingInProgress != meetingInProgress) {
            g_activeMeetingInProgress = meetingInProgress;
            fbRequestFullClear();
            needFullRedraw = true;
        }
    } else {
        if (g_mode == MODE_MEETING) {
            g_mode = MODE_WEEKLY;
            g_activeMeetingIdx = -1;
            g_activeMeetingInProgress = false;
            fbRequestFullClear();
            needFullRedraw = true;
        }
    }

    // ── Visual refresh only when the 30-minute viewport slot changes ─────────
    if (!needFullRedraw && currentHalfHourSlot != g_lastDrawnHalfHourSlot) {
        needFullRedraw = true;
    }

    if (needFullRedraw) {
        redrawScreen();
        g_lastDrawnHalfHourSlot = halfHourSlot(time(nullptr));
    }

    // Sleep until next minute boundary, polling OTA every 500ms
    { time_t t2 = time(nullptr); struct tm lt2; localtime_r(&t2, &lt2);
      unsigned long ms = (unsigned long)(59 - lt2.tm_sec) * 1000UL + 500UL;
      if (ms < 200UL) ms = 200UL;
      unsigned long deadline = millis() + ms;
      while ((long)(deadline - millis()) > 0) {
          ArduinoOTA.handle();
          delay(500);
      } }
}
